## drivers/sn/Kconfig
```kconfig
# SPDX-License-Identifier: GPL-2.0-only
#
# SGI SN (Altix) device drivers
#

menu "SN Devices"
	depends on SGI_SN

config SGI_SNSC
	bool "SGI Altix system controller communication support"
	depends on IA64_SGI_SN2
	help
	  If you have an SGI Altix and you want to enable system
	  controller communication from user space (you want this!),
	  say Y.  Otherwise, say N.

config SGI_TIOCX
	bool "SGI TIO CX driver support"
	depends on IA64_SGI_SN2
	help
	  If you have an SGI Altix and you have fpga devices attached
	  to your TIO, say Y here, otherwise say N.

config SERIAL_SGI_L1_CONSOLE
	bool "SGI Altix L1 serial console support"
	depends on IA64_SGI_SN2
	select SERIAL_CORE
	select SERIAL_CORE_CONSOLE
	help
	  If you have an SGI Altix and you would like to use the system
	  controller serial port as your console (you want this!),
	  say Y.  Otherwise, say N.

endmenu
```
